## kconfigs/Kconfig.bringup
```kconfig
config BRINGUP_SUPPORTS_CXL
	bool

config KDEVOPS_ENABLE_GUESTFS
	bool
	output yaml

config KDEVOPS_ENABLE_TERRAFORM
	bool
	output yaml

choice
	prompt "Node bring up method"
	default GUESTFS

config GUESTFS
	bool "Use guestfs-tools for local virtualization via KVM and libvirt"
	select KDEVOPS_ENABLE_GUESTFS
	select EXTRA_STORAGE_SUPPORTS_LARGEIO
	help
	  This option will use libguestfs utilities instead of Vagrant to build
	  guest images and spin them up using libvirt with KVM.

config TERRAFORM
	bool "Terraform for cloud environments"
	select EXTRA_STORAGE_SUPPORTS_512
	select EXTRA_STORAGE_SUPPORTS_1K
	select EXTRA_STORAGE_SUPPORTS_2K
	select EXTRA_STORAGE_SUPPORTS_4K
	select KDEVOPS_ENABLE_TERRAFORM
	help
	  This option enables the use of Terraform. Enable this if you want to
	  create your target nodes on a cloud provider such as:

	    * AWS
	    * Azure
	    * GCE
	    * OCI
	    * OpenStack

config SKIP_BRINGUP
	bool "Skip bring up - bare metal or existing nodes"
	select EXTRA_STORAGE_SUPPORTS_512
	select EXTRA_STORAGE_SUPPORTS_1K
	select EXTRA_STORAGE_SUPPORTS_2K
	select EXTRA_STORAGE_SUPPORTS_4K
	help
	  This option will skip bring up, as you already have existing
	  systems up and available and ssh'able. This might be the case
	  if you are working with bare metal systems or systems you may
	  have already provisioned through other means.

endchoice

config LIBVIRT
	bool
	depends on VAGRANT_LIBVIRT_SELECT || GUESTFS
	default y

source "kconfigs/Kconfig.guestfs"
source "vagrant/Kconfig"
source "terraform/Kconfig"
if LIBVIRT
source "kconfigs/Kconfig.libvirt"
endif
```

## terraform/aws/Kconfig
```kconfig
if TERRAFORM_AWS

menu "Identity & Access"
source "terraform/aws/kconfigs/identity.Kconfig"
endmenu
menu "Resource Location"
source "terraform/aws/kconfigs/location.Kconfig"
endmenu
menu "Compute"
source "terraform/aws/kconfigs/compute.Kconfig"
endmenu
menu "Storage"
source "terraform/aws/kconfigs/storage.Kconfig"
endmenu

endif # TERRAFORM_AWS
```

## terraform/azure/Kconfig
```kconfig
if TERRAFORM_AZURE

menu "Identity & Access"
source "terraform/azure/kconfigs/identity.Kconfig"
endmenu
menu "Resource Location"
source "terraform/azure/kconfigs/location.Kconfig"
endmenu
menu "Compute"
source "terraform/azure/kconfigs/compute.Kconfig"
endmenu
menu "Storage"
source "terraform/azure/kconfigs/storage.Kconfig"
endmenu

endif # TERRAFORM_AZURE
```

## terraform/gce/Kconfig
```kconfig
if TERRAFORM_GCE

menu "Identity & Access"
source "terraform/gce/kconfigs/identity.Kconfig"
endmenu
menu "Resource Location"
source "terraform/gce/kconfigs/location.Kconfig"
endmenu
menu "Compute"
source "terraform/gce/kconfigs/compute.Kconfig"
endmenu
menu "Storage"
source "terraform/gce/kconfigs/storage.Kconfig"
endmenu

endif # TERRAFORM_GCE
```

## terraform/oci/Kconfig
```kconfig
if TERRAFORM_OCI

config TERRAFORM_OCI_REGION
	string "OCI Region"
	help
	  This option will set the OCI resource location.
	  Read this:
	  https://docs.oracle.com/en-us/iaas/Content/API/SDKDocs/terraformproviderconfiguration.htm

config TERRAFORM_OCI_TENANCY_OCID
	string "OCI tenant OCID"
	help
	  The OCI ID of the tenancy to use.
	  Read this:
	  https://docs.oracle.com/en-us/iaas/Content/API/SDKDocs/terraformproviderconfiguration.htm

config TERRAFORM_OCI_USER_OCID
	string "OCI user OCID"
	help
	  The OCI ID of the user to use.
	  Read this:
	  https://docs.oracle.com/en-us/iaas/Content/API/SDKDocs/terraformproviderconfiguration.htm

config TERRAFORM_OCI_USER_PRIVATE_KEY_PATH
	string "OCI user private key path"
	help
	  Path to the file containing the private key of the user.
	  Read this:
	  https://docs.oracle.com/en-us/iaas/Content/API/SDKDocs/terraformproviderconfiguration.htm

config TERRAFORM_OCI_USER_FINGERPRINT
	string "OCI user fingerprint"
	help
	  Fingerprint for the key pair being used.
	  Read this:
	  https://docs.oracle.com/en-us/iaas/Content/API/SDKDocs/terraformproviderconfiguration.htm

config TERRAFORM_OCI_AVAILABLITY_DOMAIN
	string "OCI availablity domain"
	help
	  The name of the availability domain.
	  Read this:
	  https://docs.oracle.com/en-us/iaas/Content/API/SDKDocs/terraformproviderconfiguration.htm

config TERRAFORM_OCI_COMPARTMENT_OCID
	string "OCI compartment OCID"
	help
	  The OCI ID of user's compartment.
	  Read this:
	  https://docs.oracle.com/en-us/iaas/Content/API/SDKDocs/terraformproviderconfiguration.htm

choice
	prompt "OCI shape"
	default TERRAFORM_OCI_SHAPE_VM_STANDARD3_FLEX
	help
	  This option selects the class of virtual hardware (CPUs and
	  memory) to provision for each target node. Most CPU
	  architectures, including x86, run two threads per physical
	  core, so one OCPU is the equal of two vCPUs for x86-based
	  compute.

	  Note that your subscription might limit which shapes are
	  available for you to use.

	  More information is available here:

	  https://docs.oracle.com/en-us/iaas/Content/API/SDKDocs/terraformproviderconfiguration.htm

config TERRAFORM_OCI_SHAPE_VM_STANDARD3_FLEX
	bool "VM.Standard3.Flex"
	depends on TARGET_ARCH_X86_64
	help
	  Selecting this option provisions each guest with between 1
	  and 32 OCPUs (physical cores) and up to 512MB of memory.

config TERRAFORM_OCI_SHAPE_VM_STANDARD_E4_FLEX
	bool "VM.Standard.E4.Flex"
	depends on TARGET_ARCH_X86_64
	help
	  Selecting this option provisions each guest with between 1
	  and 114 OCPUs (physical AMD cores) and up to 1760MB of memory.

config TERRAFORM_OCI_SHAPE_VM_STANDARD_E5_FLEX
	bool "VM.Standard.E5.Flex"
	depends on TARGET_ARCH_X86_64
	help
	  Selecting this option provisions each guest with between 1
	  and 94 OCPUs (physical AMD cores) and up to 1048MB of memory.

config TERRAFORM_OCI_SHAPE_VM_STANDARD_A1_FLEX
	bool "VM.Standard.A1.Flex"
	depends on TARGET_ARCH_ARM64
	help
	  Selecting this option provisions each guest with between 1
	  and 80 OCPUs (physical ARM cores) and up to 512MB of memory.

config TERRAFORM_OCI_SHAPE_VM_STANDARD_A2_FLEX
	bool "VM.Standard.A2.Flex"
	depends on TARGET_ARCH_ARM64
	help
	  Selecting this option provisions each guest with between 1
	  and 78 OCPUs (physical ARM cores) and up to 946MB of memory.

endchoice

config TERRAFORM_OCI_SHAPE
	string
	default "VM.Standard3.Flex" if TERRAFORM_OCI_SHAPE_VM_STANDARD3_FLEX
	default "VM.Standard.E4.Flex" if TERRAFORM_OCI_SHAPE_VM_STANDARD_E4_FLEX
	default "VM.Standard.E5.Flex" if TERRAFORM_OCI_SHAPE_VM_STANDARD_E5_FLEX
	default "VM.Standard.A1.Flex" if TERRAFORM_OCI_SHAPE_VM_STANDARD_A1_FLEX
	default "VM.Standard.A2.Flex" if TERRAFORM_OCI_SHAPE_VM_STANDARD_A2_FLEX

config TERRAFORM_OCI_INSTANCE_FLEX_OCPUS
	int "Number of flexible instance OCPUs"
	default 2
	help
	  The number of OCPUs to use per flexible instance.

config TERRAFORM_OCI_INSTANCE_FLEX_MEMORY_IN_GBS
	int "How much RAM to use per flexible instance in GB"
	default 4
	help
	  How much GiB of RAM to use per flexible instance.

config TERRAFORM_OCI_OS_IMAGE_OCID
	string "OCI OS image OCID"
	help
	  The OCI ID of the OS image to use.
	  Read this:
	  https://docs.oracle.com/en-us/iaas/Content/API/SDKDocs/terraformproviderconfiguration.htm

config TERRAFORM_OCI_ASSIGN_PUBLIC_IP
	bool "Assign public IP address to the cloud instance"
	default y
	help
          Select this field if public IP address has to be assigned to
          the cloud instance. Otherwise a public IP address is
          assigned.

config TERRAFORM_OCI_SUBNET_OCID
	string "OCI Subnet OCID"
	help
	  The OCI ID of the subnet.
	  Read this:
	  https://docs.oracle.com/en-us/iaas/Content/API/SDKDocs/terraformproviderconfiguration.htm

config TERRAFORM_OCI_VOLUMES_ENABLE_EXTRA
	bool "Enable additional block devices"
	default n
	help
	  Enable this to provision up to 10 extra block devices
	  on each target node.

if TERRAFORM_OCI_VOLUMES_ENABLE_EXTRA

choice
	prompt "Count of extra block volumes"
	default TERRAFORM_OCI_VOLUMES_PER_INSTANCE_4
	help
	  The count of extra block devices attached to each target
	  node.

config TERRAFORM_OCI_VOLUMES_PER_INSTANCE_2
	bool "2"
	help
	  Provision 2 extra volumes per target node.

config TERRAFORM_OCI_VOLUMES_PER_INSTANCE_3
	bool "3"
	help
	  Provision 3 extra volumes per target node.

config TERRAFORM_OCI_VOLUMES_PER_INSTANCE_4
	bool "4"
	help
	  Provision 4 extra volumes per target node.

config TERRAFORM_OCI_VOLUMES_PER_INSTANCE_5
	bool "5"
	help
	  Provision 5 extra volumes per target node.

config TERRAFORM_OCI_VOLUMES_PER_INSTANCE_6
	bool "6"
	help
	  Provision 6 extra volumes per target node.

config TERRAFORM_OCI_VOLUMES_PER_INSTANCE_7
	bool "7"
	help
	  Provision 7 extra volumes per target node.

config TERRAFORM_OCI_VOLUMES_PER_INSTANCE_8
	bool "8"
	help
	  Provision 8 extra volumes per target node.

config TERRAFORM_OCI_VOLUMES_PER_INSTANCE_9
	bool "9"
	help
	  Provision 9 extra volumes per target node.

config TERRAFORM_OCI_VOLUMES_PER_INSTANCE_10
	bool "10"
	help
	  Provision 10 extra volumes per target node.

endchoice

config TERRAFORM_OCI_VOLUMES_PER_INSTANCE
	int
	output yaml
	default 2 if TERRAFORM_OCI_VOLUMES_PER_INSTANCE_2
	default 3 if TERRAFORM_OCI_VOLUMES_PER_INSTANCE_3
	default 4 if TERRAFORM_OCI_VOLUMES_PER_INSTANCE_4
	default 5 if TERRAFORM_OCI_VOLUMES_PER_INSTANCE_5
	default 6 if TERRAFORM_OCI_VOLUMES_PER_INSTANCE_6
	default 7 if TERRAFORM_OCI_VOLUMES_PER_INSTANCE_7
	default 8 if TERRAFORM_OCI_VOLUMES_PER_INSTANCE_8
	default 9 if TERRAFORM_OCI_VOLUMES_PER_INSTANCE_9
	default 10 if TERRAFORM_OCI_VOLUMES_PER_INSTANCE_10

choice
	prompt "Volume size for each additional volume"
	default TERRAFORM_OCI_VOLUMES_SIZE_50G
	help
	  OCI implements volume sizes between 50G and 32T. In some
	  cases, 50G volumes are in the free tier.

config TERRAFORM_OCI_VOLUMES_SIZE_50G
	bool "50G"
	help
	  Extra block volumes are 50 GiB in size.

config TERRAFORM_OCI_VOLUMES_SIZE_64G
	bool "64G"
	help
	  Extra block volumes are 64 GiB in size.

config TERRAFORM_OCI_VOLUMES_SIZE_128G
	bool "128G"
	help
	  Extra block volumes are 128 GiB in size.

config TERRAFORM_OCI_VOLUMES_SIZE_256G
	bool "256G"
	help
	  Extra block volumes are 256 GiB in size.

config TERRAFORM_OCI_VOLUMES_SIZE_512G
	bool "512G"
	help
	  Extra block volumes are 512 GiB in size.

config TERRAFORM_OCI_VOLUMES_SIZE_1024G
	bool "1024G"
	help
	  Extra block volumes are 1024 GiB in size.

config TERRAFORM_OCI_VOLUMES_SIZE_2048G
	bool "2048G"
	help
	  Extra block volumes are 2048 GiB in size.

config TERRAFORM_OCI_VOLUMES_SIZE_4096G
	bool "4096G"
	help
	  Extra block volumes are 4096 GiB in size.

config TERRAFORM_OCI_VOLUMES_SIZE_8192G
	bool "8192G"
	help
	  Extra block volumes are 8192 GiB in size.

endchoice

config TERRAFORM_OCI_VOLUMES_SIZE
	int
	output yaml
	default 50 if TERRAFORM_OCI_VOLUMES_SIZE_50G
	default 64 if TERRAFORM_OCI_VOLUMES_SIZE_64G
	default 128 if TERRAFORM_OCI_VOLUMES_SIZE_128G
	default 256 if TERRAFORM_OCI_VOLUMES_SIZE_256G
	default 512 if TERRAFORM_OCI_VOLUMES_SIZE_512G
	default 1024 if TERRAFORM_OCI_VOLUMES_SIZE_1024G
	default 2048 if TERRAFORM_OCI_VOLUMES_SIZE_2048G
	default 4096 if TERRAFORM_OCI_VOLUMES_SIZE_4096G
	default 8192 if TERRAFORM_OCI_VOLUMES_SIZE_8192G

endif # TERRAFORM_OCI_VOLUMES_ENABLE_EXTRA

if !TERRAFORM_OCI_VOLUMES_ENABLE_EXTRA

config TERRAFORM_OCI_DATA_VOLUME_DISPLAY_NAME
	string "Display name to use for the data volume"
	default "data"
	help
	  Human readable data volume instance name
	  Read this:
	  https://docs.oracle.com/en-us/iaas/Content/API/SDKDocs/terraformproviderconfiguration.htm

endif # !TERRAFORM_OCI_VOLUMES_ENABLE_EXTRA

config TERRAFORM_OCI_DATA_VOLUME_DEVICE_FILE_NAME
	string "Data volume's device file name"
	default "/dev/oracleoci/oraclevdb"
	help
	  Data volume's device file name
	  Read this:
	  https://docs.oracle.com/en-us/iaas/Content/API/SDKDocs/terraformproviderconfiguration.htm

if !TERRAFORM_OCI_VOLUMES_ENABLE_EXTRA

config TERRAFORM_OCI_SPARSE_VOLUME_DISPLAY_NAME
	string "Display name to use for the sparse volume"
	default "sparse"
	help
	  Human readable sparse volume instance name
	  Read this:
	  https://docs.oracle.com/en-us/iaas/Content/API/SDKDocs/terraformproviderconfiguration.htm

endif # !TERRAFORM_OCI_VOLUMES_ENABLE_EXTRA

config TERRAFORM_OCI_SPARSE_VOLUME_DEVICE_FILE_NAME
	string "Sparse volume's device file name"
	default "/dev/oracleoci/oraclevdc"
	help
	  Sparse volume's device file name
	  Read this:
	  https://docs.oracle.com/en-us/iaas/Content/API/SDKDocs/terraformproviderconfiguration.htm

endif # TERRAFORM_OCI
```

## workflows/rdstcp/Kconfig
```kconfig
if KDEVOPS_WORKFLOW_ENABLE_RDSTCP

config RDSTCP_REPO
	string "The rds-tools repository"
	default "https://github.com/oracle/rds-tools.git"
	help
	  The rds-tools repository to clone.

config RDSTCP_REPO_COMMIT
	string "The version of rds-tools to check out"
	default "master"
	help
	  The version of rds-tools to be used for the tests.

if KDEVOPS_WORKFLOW_DEDICATE_RDSTCP

config RDSTCP_TEST_GROUP_PING
	bool "Enable the rds-ping testing section"
	default n
	help
	  Build and install the rds-ping tool on the target nodes.

config RDSTCP_TEST_GROUP_STRESS
	bool "Enable the rds-stress testing section"
	default n
	help
	  Build and install the rds-stress tool on the target nodes.

endif # KDEVOPS_WORKFLOW_DEDICATE_RDSTCP

endif # KDEVOPS_WORKFLOW_ENABLE_RDSTCP
```
