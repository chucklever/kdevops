## terraform/azure/kconfigs/Kconfig.compute
```kconfig
choice
	prompt "Azure vmsize"
	default TERRAFORM_AZURE_VM_SIZE_STANDARD_D2S_V4
	help
	  This option chooses the size of the virtual machine instances
	  to be created for the kdevops target nodes.

config TERRAFORM_AZURE_VM_SIZE_STANDARD_B1S
	bool "Standard_B1s"
	depends on TARGET_ARCH_X86_64
	help
	  1 vCPU, 1GiB of memory.

	  Azure documentation notes that this size is part of a
	  previous generation series.

config TERRAFORM_AZURE_VM_SIZE_STANDARD_B2S
	bool "Standard_B2s"
	depends on TARGET_ARCH_X86_64
	help
	  2 vCPUs, 4GiB of memory.

	  Azure documentation notes that this size is part of a
	  previous generation series.

config TERRAFORM_AZURE_VM_SIZE_STANDARD_B4MS
	bool "Standard_B4ms"
	depends on TARGET_ARCH_X86_64
	help
	  4 vCPUs, 16GiB of memory.

	  Azure documentation notes that this size is part of a
	  previous generation series.

config TERRAFORM_AZURE_VM_SIZE_STANDARD_B8MS
	bool "Standard_B8ms"
	depends on TARGET_ARCH_X86_64
	help
	  8 vCPUs, 32GiB of memory.

	  Azure documentation notes that this size is part of a
	  previous generation series.

config TERRAFORM_AZURE_VM_SIZE_STANDARD_B12MS
	bool "Standard_B12ms"
	depends on TARGET_ARCH_X86_64
	help
	  12 vCPUs, 48GiB of memory.

	  Azure documentation notes that this size is part of a
	  previous generation series.

config TERRAFORM_AZURE_VM_SIZE_STANDARD_B16MS
	bool "Standard_B16ms"
	depends on TARGET_ARCH_X86_64
	help
	  16 vCPUs, 64GiB of memory.

	  Azure documentation notes that this size is part of a
	  previous generation series.

config TERRAFORM_AZURE_VM_SIZE_STANDARD_B20MS
	bool "Standard_B20ms"
	depends on TARGET_ARCH_X86_64
	help
	  20 vCPUs, 80GiB of memory.

	  Azure documentation notes that this size is part of a
	  previous generation series.

config TERRAFORM_AZURE_VM_SIZE_STANDARD_B2TS_V2
	bool "Standard_B2ts_v2"
	depends on TARGET_ARCH_X86_64
	help
	  2 vCPUs, 1GiB of memory.

	  The B family is described here:

	  https://learn.microsoft.com/en-us/azure/virtual-machines/sizes/general-purpose/b-family?source=recommendations

config TERRAFORM_AZURE_VM_SIZE_STANDARD_B2LS_V2
	bool "Standard_B2ls_v2"
	depends on TARGET_ARCH_X86_64
	help
	  2 vCPUs, 4GiB of memory.

	  The B family is described here:

	  https://learn.microsoft.com/en-us/azure/virtual-machines/sizes/general-purpose/b-family?source=recommendations

config TERRAFORM_AZURE_VM_SIZE_STANDARD_B2S_V2
	bool "Standard_B2s_v2"
	depends on TARGET_ARCH_X86_64
	help
	  2 vCPUs, 4GiB of memory.

	  The B family is described here:

	  https://learn.microsoft.com/en-us/azure/virtual-machines/sizes/general-purpose/b-family?source=recommendations

config TERRAFORM_AZURE_VM_SIZE_STANDARD_B4LS_V2
	bool "Standard_B4ls_v2"
	depends on TARGET_ARCH_X86_64
	help
	  4 vCPUs, 8GiB of memory.

	  The B family is described here:

	  https://learn.microsoft.com/en-us/azure/virtual-machines/sizes/general-purpose/b-family?source=recommendations

config TERRAFORM_AZURE_VM_SIZE_STANDARD_B4S_V2
	bool "Standard_B4s_v2"
	depends on TARGET_ARCH_X86_64
	help
	  4 vCPUs, 16GiB of memory.

	  The B family is described here:

	  https://learn.microsoft.com/en-us/azure/virtual-machines/sizes/general-purpose/b-family?source=recommendations

config TERRAFORM_AZURE_VM_SIZE_STANDARD_B8LS_V2
	bool "Standard_B8ls_v2"
	depends on TARGET_ARCH_X86_64
	help
	  8 vCPUs, 16GiB of memory.

	  The B family is described here:

	  https://learn.microsoft.com/en-us/azure/virtual-machines/sizes/general-purpose/b-family?source=recommendations

config TERRAFORM_AZURE_VM_SIZE_STANDARD_B8S_V2
	bool "Standard_B8s_v2"
	depends on TARGET_ARCH_X86_64
	help
	  8 vCPUs, 32GiB of memory.

	  The B family is described here:

	  https://learn.microsoft.com/en-us/azure/virtual-machines/sizes/general-purpose/b-family?source=recommendations

config TERRAFORM_AZURE_VM_SIZE_STANDARD_B16LS_V2
	bool "Standard_B16ls_v2"
	depends on TARGET_ARCH_X86_64
	help
	  16 vCPUs, 32GiB of memory.

	  The B family is described here:

	  https://learn.microsoft.com/en-us/azure/virtual-machines/sizes/general-purpose/b-family?source=recommendations

config TERRAFORM_AZURE_VM_SIZE_STANDARD_B16S_V2
	bool "Standard_B16s_v2"
	depends on TARGET_ARCH_X86_64
	help
	  16 vCPUs, 64GiB of memory.

	  The B family is described here:

	  https://learn.microsoft.com/en-us/azure/virtual-machines/sizes/general-purpose/b-family?source=recommendations

config TERRAFORM_AZURE_VM_SIZE_STANDARD_B32LS_V2
	bool "Standard_B32ls_v2"
	depends on TARGET_ARCH_X86_64
	help
	  32 vCPUs, 64GiB of memory.

	  The B family is described here:

	  https://learn.microsoft.com/en-us/azure/virtual-machines/sizes/general-purpose/b-family?source=recommendations

config TERRAFORM_AZURE_VM_SIZE_STANDARD_B32S_V2
	bool "Standard_B32s_v2"
	depends on TARGET_ARCH_X86_64
	help
	  32 vCPUs, 128GiB of memory.

	  The B family is described here:

	  https://learn.microsoft.com/en-us/azure/virtual-machines/sizes/general-purpose/b-family?source=recommendations

config TERRAFORM_AZURE_VM_SIZE_STANDARD_DS1_V2
	bool "Standard_DS1_v2"
	depends on TARGET_ARCH_X86_64
	help
	  This virtual machine size has one vCPU and 3.5GB of memory.
	  Azure documentation notes that this size is part of a
	  previous generation series, and is to become unavailable
	  after May 1, 2028.

config TERRAFORM_AZURE_VM_SIZE_STANDARD_DS3_V2
	bool "Standard_DS3_v2"
	depends on TARGET_ARCH_X86_64
	help
	  This virtual machine size has four vCPUs and 14GB of memory.
	  Azure documentation notes that this size is part of a
	  previous generation series, and is to become unavailable
	  after May 1, 2028.

config TERRAFORM_AZURE_VM_SIZE_STANDARD_D2S_V3
	bool "Standard_D2s_v3"
	depends on TARGET_ARCH_X86_64
	help
	  This virtual machine size has two vCPUs and 8GB of memory.

config TERRAFORM_AZURE_VM_SIZE_STANDARD_D4S_V3
	bool "Standard_D4s_v3"
	depends on TARGET_ARCH_X86_64
	help
	  This virtual machine size has four vCPUs and 16GB of memory.

config TERRAFORM_AZURE_VM_SIZE_STANDARD_D8S_V3
	bool "Standard_D8s_v3"
	depends on TARGET_ARCH_X86_64
	help
	  This virtual machine size has eight vCPUs and 32GB of memory.

config TERRAFORM_AZURE_VM_SIZE_STANDARD_D2S_V4
	bool "Standard_D2s_v4"
	depends on TARGET_ARCH_X86_64
	help
	  This virtual machine size has two vCPUs and 8GB of memory.

config TERRAFORM_AZURE_VM_SIZE_STANDARD_D4S_V4
	bool "Standard_D4s_v4"
	depends on TARGET_ARCH_X86_64
	help
	  This virtual machine size has four vCPUs and 16GB of memory.

config TERRAFORM_AZURE_VM_SIZE_STANDARD_D8S_V4
	bool "Standard_D8s_v4"
	depends on TARGET_ARCH_X86_64
	help
	  This virtual machine size has eight vCPUs and 32GB of memory.

config TERRAFORM_AZURE_VM_SIZE_STANDARD_D2S_V6
	bool "Standard_D2s_v6"
	depends on TARGET_ARCH_X86_64
	help
	  This virtual machine size has two vCPUs and 8GB of memory.

config TERRAFORM_AZURE_VM_SIZE_STANDARD_D4S_V6
	bool "Standard_D4s_v6"
	depends on TARGET_ARCH_X86_64
	help
	  This virtual machine size has four vCPUs and 16GB of memory.

config TERRAFORM_AZURE_VM_SIZE_STANDARD_D8S_V6
	bool "Standard_D8s_v6"
	depends on TARGET_ARCH_X86_64
	help
	  This virtual machine size has eight vCPUs and 32GB of memory.

endchoice

config TERRAFORM_AZURE_VM_SIZE
	string
	output yaml
	default "Standard_B1s" if TERRAFORM_AZURE_VM_SIZE_STANDARD_B1S
	default "Standard_B2s" if TERRAFORM_AZURE_VM_SIZE_STANDARD_B2S
	default "Standard_B4ms" if TERRAFORM_AZURE_VM_SIZE_STANDARD_B4MS
	default "Standard_B8ms" if TERRAFORM_AZURE_VM_SIZE_STANDARD_B8MS
	default "Standard_B12ms" if TERRAFORM_AZURE_VM_SIZE_STANDARD_B12MS
	default "Standard_B16ms" if TERRAFORM_AZURE_VM_SIZE_STANDARD_B16MS
	default "Standard_B20ms" if TERRAFORM_AZURE_VM_SIZE_STANDARD_B20MS
	default "Standard_B2ts_v2" if TERRAFORM_AZURE_VM_SIZE_STANDARD_B2TS_V2
	default "Standard_B2ls_v2" if TERRAFORM_AZURE_VM_SIZE_STANDARD_B2LS_V2
	default "Standard_B2s_v2" if TERRAFORM_AZURE_VM_SIZE_STANDARD_B2S_V2
	default "Standard_B4ls_v2" if TERRAFORM_AZURE_VM_SIZE_STANDARD_B4LS_V2
	default "Standard_B4s_v2" if TERRAFORM_AZURE_VM_SIZE_STANDARD_B4S_V2
	default "Standard_B8ls_v2" if TERRAFORM_AZURE_VM_SIZE_STANDARD_B8LS_V2
	default "Standard_B8s_v2" if TERRAFORM_AZURE_VM_SIZE_STANDARD_B8S_V2
	default "Standard_B16ls_v2" if TERRAFORM_AZURE_VM_SIZE_STANDARD_B16LS_V2
	default "Standard_B16s_v2" if TERRAFORM_AZURE_VM_SIZE_STANDARD_B16S_V2
	default "Standard_B32ls_v2" if TERRAFORM_AZURE_VM_SIZE_STANDARD_B32LS_V2
	default "Standard_B32s_v2" if TERRAFORM_AZURE_VM_SIZE_STANDARD_B32S_V2
	default "Standard_DS1_v2" if TERRAFORM_AZURE_VM_SIZE_STANDARD_DS1_V2
	default "Standard_DS3_v2" if TERRAFORM_AZURE_VM_SIZE_STANDARD_DS3_V2
	default "Standard_D2s_v3" if TERRAFORM_AZURE_VM_SIZE_STANDARD_D2S_V3
	default "Standard_D4s_v3" if TERRAFORM_AZURE_VM_SIZE_STANDARD_D4S_V3
	default "Standard_D8s_v3" if TERRAFORM_AZURE_VM_SIZE_STANDARD_D8S_V3
	default "Standard_D2s_v4" if TERRAFORM_AZURE_VM_SIZE_STANDARD_D2S_V4
	default "Standard_D4s_v4" if TERRAFORM_AZURE_VM_SIZE_STANDARD_D4S_V4
	default "Standard_D8s_v4" if TERRAFORM_AZURE_VM_SIZE_STANDARD_D8S_V4
	default "Standard_D2s_v6" if TERRAFORM_AZURE_VM_SIZE_STANDARD_D2S_V6
	default "Standard_D4s_v6" if TERRAFORM_AZURE_VM_SIZE_STANDARD_D4S_V6
	default "Standard_D8s_v6" if TERRAFORM_AZURE_VM_SIZE_STANDARD_D8S_V6

config TERRAFORM_AZURE_ACCELERATED_NETWORKING_ENABLED
	bool
	output yaml
	default n if TERRAFORM_AZURE_VM_SIZE_STANDARD_B1S
	default n if TERRAFORM_AZURE_VM_SIZE_STANDARD_B2S
	default n if TERRAFORM_AZURE_VM_SIZE_STANDARD_B4MS
	default n if TERRAFORM_AZURE_VM_SIZE_STANDARD_B8MS
	default n if TERRAFORM_AZURE_VM_SIZE_STANDARD_B12MS
	default n if TERRAFORM_AZURE_VM_SIZE_STANDARD_B16MS
	default n if TERRAFORM_AZURE_VM_SIZE_STANDARD_B20MS
	default n if TERRAFORM_AZURE_VM_SIZE_STANDARD_B2TS_V2
	default n if TERRAFORM_AZURE_VM_SIZE_STANDARD_B2LS_V2
	default n if TERRAFORM_AZURE_VM_SIZE_STANDARD_B2S_V2
	default n if TERRAFORM_AZURE_VM_SIZE_STANDARD_B4LS_V2
	default n if TERRAFORM_AZURE_VM_SIZE_STANDARD_B4S_V2
	default n if TERRAFORM_AZURE_VM_SIZE_STANDARD_B8LS_V2
	default n if TERRAFORM_AZURE_VM_SIZE_STANDARD_B8S_V2
	default n if TERRAFORM_AZURE_VM_SIZE_STANDARD_B16LS_V2
	default n if TERRAFORM_AZURE_VM_SIZE_STANDARD_B16S_V2
	default n if TERRAFORM_AZURE_VM_SIZE_STANDARD_B32LS_V2
	default n if TERRAFORM_AZURE_VM_SIZE_STANDARD_B32S_V2
	default n if TERRAFORM_AZURE_VM_SIZE_STANDARD_DS1_V2
	default n if TERRAFORM_AZURE_VM_SIZE_STANDARD_DS3_V2
	default y if TERRAFORM_AZURE_VM_SIZE_STANDARD_D2S_V3
	default y if TERRAFORM_AZURE_VM_SIZE_STANDARD_D4S_V3
	default y if TERRAFORM_AZURE_VM_SIZE_STANDARD_D8S_V3
	default y if TERRAFORM_AZURE_VM_SIZE_STANDARD_D2S_V4
	default y if TERRAFORM_AZURE_VM_SIZE_STANDARD_D4S_V4
	default y if TERRAFORM_AZURE_VM_SIZE_STANDARD_D8S_V4
	default y if TERRAFORM_AZURE_VM_SIZE_STANDARD_D2S_V6
	default y if TERRAFORM_AZURE_VM_SIZE_STANDARD_D4S_V6
	default y if TERRAFORM_AZURE_VM_SIZE_STANDARD_D8S_V6

choice
	prompt "Azure image publisher"
	default TERRAFORM_AZURE_IMAGE_PUBLISHER_DEBIAN
	help
	  This option specifies the publisher of the boot image used to
	  create the kdevops target nodes.

config TERRAFORM_AZURE_IMAGE_PUBLISHER_DEBIAN
	bool "Debian"
	help
	  This option sets the boot image publisher to "Debian".

config TERRAFORM_AZURE_IMAGE_PUBLISHER_REDHAT
	bool "Red Hat"
	help
	  This option sets the boot image publisher to "RedHat".

endchoice

config TERRAFORM_AZURE_IMAGE_PUBLISHER
	string
	output yaml
	default "Debian" if TERRAFORM_AZURE_IMAGE_PUBLISHER_DEBIAN
	default "RedHat" if TERRAFORM_AZURE_IMAGE_PUBLISHER_REDHAT

source "terraform/azure/kconfigs/publishers/Kconfig.debian"
source "terraform/azure/kconfigs/publishers/Kconfig.rhel"
```

## terraform/gce/kconfigs/Kconfig.cloud_build
```kconfig
if BOOTLINUX_CLOUD_BUILD

config TERRAFORM_GCE_CLOUD_BUILD_BUCKET
	string "GCS bucket name for kernel artifacts"
	output yaml
	default ""
	help
	  Name of the GCS bucket where Cloud Build stores kernel
	  artifacts. If left empty, a bucket name is generated from
	  the project ID with a random suffix to ensure uniqueness.

config TERRAFORM_GCE_CLOUD_BUILD_RETENTION_DAYS
	int "Artifact retention period (days)"
	output yaml
	default 30
	help
	  Number of days to retain kernel artifacts in the GCS
	  bucket before automatic deletion. Older artifacts are
	  cleaned up to manage storage costs.

choice
	prompt "Cloud Build machine type"
	default TERRAFORM_GCE_CLOUD_BUILD_MACHINE_E2_HIGHCPU_8
	help
	  Machine type for Cloud Build workers. Larger machines
	  reduce build time but increase cost.

config TERRAFORM_GCE_CLOUD_BUILD_MACHINE_E2_MEDIUM
	bool "E2_MEDIUM"
	help
	  E2 machine with 1 vCPU and 4GB memory. Lowest cost option,
	  suitable for small builds.

config TERRAFORM_GCE_CLOUD_BUILD_MACHINE_E2_HIGHCPU_8
	bool "E2_HIGHCPU_8"
	help
	  E2 high-CPU machine with 8 vCPUs and 8GB memory. Good
	  balance of cost and performance for kernel builds.

config TERRAFORM_GCE_CLOUD_BUILD_MACHINE_E2_HIGHCPU_32
	bool "E2_HIGHCPU_32"
	help
	  E2 high-CPU machine with 32 vCPUs and 32GB memory. Faster
	  builds at higher cost.

config TERRAFORM_GCE_CLOUD_BUILD_MACHINE_N1_HIGHCPU_8
	bool "N1_HIGHCPU_8"
	help
	  N1 high-CPU machine with 8 vCPUs and 7.2GB memory.

config TERRAFORM_GCE_CLOUD_BUILD_MACHINE_N1_HIGHCPU_32
	bool "N1_HIGHCPU_32"
	help
	  N1 high-CPU machine with 32 vCPUs and 28.8GB memory.
	  Fastest builds at highest cost.

endchoice

config TERRAFORM_GCE_CLOUD_BUILD_MACHINE_TYPE
	string
	output yaml
	default "E2_MEDIUM" if TERRAFORM_GCE_CLOUD_BUILD_MACHINE_E2_MEDIUM
	default "E2_HIGHCPU_8" if TERRAFORM_GCE_CLOUD_BUILD_MACHINE_E2_HIGHCPU_8
	default "E2_HIGHCPU_32" if TERRAFORM_GCE_CLOUD_BUILD_MACHINE_E2_HIGHCPU_32
	default "N1_HIGHCPU_8" if TERRAFORM_GCE_CLOUD_BUILD_MACHINE_N1_HIGHCPU_8
	default "N1_HIGHCPU_32" if TERRAFORM_GCE_CLOUD_BUILD_MACHINE_N1_HIGHCPU_32

endif # BOOTLINUX_CLOUD_BUILD
```

## workflows/linux/Kconfig.cloud_build
```kconfig
if BOOTLINUX_CLOUD_BUILD

config BOOTLINUX_CLOUD_BUILD_TIMEOUT
	int "Cloud build timeout (minutes)"
	output yaml
	default 60
	help
	  Maximum time in minutes for the cloud build to complete.
	  A full kernel build with modules typically takes 15-45
	  minutes depending on the machine type. Set a higher value
	  if building with many modules or on smaller instances.

endif # BOOTLINUX_CLOUD_BUILD
```
